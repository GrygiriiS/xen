## xen/arch/arm/configs/xt_defconfig
```kconfig
CONFIG_XSM=y
CONFIG_TEE=y
CONFIG_OPTEE=y
CONFIG_IPMMU_VMSA=y
CONFIG_IOREQ_SERVER=y
CONFIG_PCI_PASSTHROUGH=y
CONFIG_VIRTIO_PCI=y
CONFIG_EXPERT=y
CONFIG_RCAR4=y

CONFIG_EARLY_UART_CHOICE_SCIF=y
CONFIG_EARLY_UART_SCIF=y
CONFIG_EARLY_PRINTK=y
CONFIG_EARLY_UART_BASE_ADDRESS=0xe6540000
CONFIG_EARLY_UART_SCIF_VERSION_NONE=y

##CONFIG_STATIC_MEMORY=y
CONFIG_ARM_SCI=y
CONFIG_SCMI_SMC=y
CONFIG_HOST_DTB_EXPORT=y
#CONFIG_ACCESS_CONTROLLER=y
```
