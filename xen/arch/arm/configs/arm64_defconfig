## xen/arch/arm/configs/arm64_defconfig
```kconfig
CONFIG_UNSUPPORTED=y
CONFIG_EARLY_UART_CHOICE_SCIF=y
CONFIG_EARLY_UART_SCIF=y
CONFIG_EARLY_PRINTK=y
CONFIG_EARLY_UART_BASE_ADDRESS=0xe6540000
CONFIG_EARLY_UART_SCIF_VERSION_NONE=y
CONFIG_IPMMU_VMSA=y

CONFIG_ARM_SCI=y
CONFIG_SCMI_SMC_MA=y
```

## xen/arch/arm/firmware/Kconfig
```kconfig
config ARM_SCI
	bool
	depends on ARM
	help
	  This option enables generic Arm SCI (System Control Interface) mediators
	  support. It allows domains to control system resources via one of
	  Arm SCI mediators drivers implemented in XEN, like SCMI.

menu "Firmware Drivers"

choice
	prompt "ARM SCI driver type"
	default SCMI_SMC
	help
	Choose which ARM SCI driver to enable.

config ARM_SCI_NONE
	bool "none"

config SCMI_SMC
	bool "Forward SCMI over SMC calls from hwdom to EL3 firmware"
	select ARM_SCI
	help
	  This option enables basic awareness for SCMI calls using SMC as
	  doorbell mechanism and Shared Memory for transport ("arm,scmi-smc"
	  compatible only). The value of "arm,smc-id" DT property from SCMI
	  firmware node is used to trap and forward corresponding SCMI SMCs
	  to firmware running at EL3, for calls coming from the hardware domain or
	  driver domain.
	  Use with EL3 firmware which supports only single SCMI OSPM agent.

config SCMI_SMC_MA
	bool "Enable ARM SCMI SMC multi-agent driver"
	select ARM_SCI
	help
	  Enables SCMI SMC/HVC multi-agent in XEN to pass SCMI requests from Domains
	  to EL3 firmware (TF-A) which supports multi-agent feature.
	  This feature allows to enable SCMI per Domain using unique SCMI agent_id,
	  so Domain is identified by EL3 firmware as an SCMI Agent and can access
	  allowed platform resources through dedicated SMC/HVC Shared memory based
	  transport.

endchoice

endmenu
```

## xen/arch/arm/sci/Kconfig
```kconfig
config ARM_SCI
	bool "Enable ARM_SCI mediators support"
	depends on ARM
	default n
	help
	  This option enables generic Arm SCI (System Control Interface) mediators
	  support. It allows domains to control system resourcess via one of
	  Arm SCI mediators drivers implemented in XEN, like SCMI.

if ARM_SCI

choice
	prompt "ARM_SCI mediator type"
	default SCMI_SMC_DOM0
	help
	Choose which ARM_SCI mediator to enable.

	If unsure, choose SCMI_SMC_DOM0.

config SCMI_SMC_DOM0
	bool "Enable forwarding SCMI over SMC calls from Dom0 to EL3 firmware"
	default y
	help
	  This option enables basic awareness for SCMI calls using SMC as
	  doorbell mechanism and Shared Memory for transport ("arm,scmi-smc"
	  compatible only). The value of "arm,smc-id" DT property from SCMI
	  firmware node is used to trap and forward corresponding SCMI SMCs
	  to firmware running at EL3, if the call comes from Dom0.

endchoice

endif
```
